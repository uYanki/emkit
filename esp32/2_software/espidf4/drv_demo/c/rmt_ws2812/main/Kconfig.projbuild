## esp32/2_software/espidf4/drv_demo/c/rmt_ws2812/main/Kconfig.projbuild
```kconfig
menu "Example Configuration"
    config EXAMPLE_RMT_TX_GPIO
        int "RMT TX GPIO"
        default 4
        help
            Set the GPIO number used for transmitting the RMT signal.

    config EXAMPLE_STRIP_LED_NUMBER
        int "Number of LEDS in a strip"
        default 8
        help
            A single RGB strip contains several LEDs.
endmenu
```
